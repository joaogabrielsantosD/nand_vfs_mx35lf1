## Kconfig
```kconfig
menu "NAND MX35 diskIO Manager Configuration"

    config VFS_NAND_MAX_OPENED_FILES
        int "Maximum opened files for NAND VFS"
        default 2
        range 1 5
        help
            Maximum number of files that can be opened simultaneously on the
            NAND Virtual File System (VFS).

    config DHARA_GARBAGE_COLLECTOR_RATIO
        int "Garbage collector ratio for NAND VFS"
        default 5
        range 1 10
        help
            Dhara reserves 1/(ratio+1) of the journal capacity for garbage collection and
            performs (ratio+1) collection steps whenever the journal is full.
            A higher value gives MORE usable capacity, but each write may trigger more
            garbage collection work (higher write amplification and latency spikes, more wear).
            A lower value reserves more space, which makes writes cheaper and reduces wear.

    config NAND_MX35_PROTECTED_MODE
        bool "Enable protected mode for NAND MX35"
        default n
        help
            Enable protected mode for NAND MX35 device. In this mode, the NAND device 
            is write-protected by default and must be unlocked before any write operation. 
            This is useful to prevent accidental writes to the NAND device.

endmenu
```
